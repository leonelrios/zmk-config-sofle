## boards/shields/mi_sofle/Kconfig.defconfig
```kconfig
if SHIELD_MI_SOFLE_LEFT

config ZMK_KEYBOARD_NAME
	default "Sofle"

config ZMK_SPLIT_ROLE_CENTRAL
	default y

endif

if SHIELD_MI_SOFLE_LEFT || SHIELD_MI_SOFLE_RIGHT

config ZMK_SPLIT
	default y

endif
```

## boards/shields/mi_sofle/Kconfig.shield
```kconfig
config SHIELD_MI_SOFLE_LEFT
	def_bool $(shields_list_contains,mi_sofle_left)

config SHIELD_MI_SOFLE_RIGHT
	def_bool $(shields_list_contains,mi_sofle_right)
```

## config/west.yml
```yaml
manifest:
  defaults:
    revision: v0.3
  remotes:
    - name: zmkfirmware
      url-base: https://github.com/zmkfirmware
    # Modulo de pantalla vertical (nice!oled)
    - name: mctechnology17
      url-base: https://github.com/mctechnology17
  projects:
    - name: zmk
      remote: zmkfirmware
      import: app/west.yml
    # Fijado a una version publicada para que no cambie solo
    - name: zmk-nice-oled
      remote: mctechnology17
      revision: v0.0.2
  self:
    path: config
```
