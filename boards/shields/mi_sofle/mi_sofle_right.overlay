#include "mi_sofle.dtsi"

&default_transform {
    col-offset = <6>;
};

&kscan0 {
    col-gpios
        = <&gpio0 9  GPIO_ACTIVE_HIGH>   // C0: Arduino 10 = P0.09
        , <&gpio0 10 GPIO_ACTIVE_HIGH>   // C1: Arduino 11 = P0.10
        , <&gpio1 11 GPIO_ACTIVE_HIGH>   // C2: Arduino 12 = P1.11
        , <&gpio1 7  GPIO_ACTIVE_HIGH>   // C3: Arduino 20 = P1.07
        , <&gpio0 20 GPIO_ACTIVE_HIGH>   // C4: Arduino 3  = P0.20
        , <&gpio0 8  GPIO_ACTIVE_HIGH>   // C5: Arduino 1  = P0.08
        ;

    row-gpios
        = <&gpio0 6  (GPIO_ACTIVE_HIGH | GPIO_PULL_DOWN)>   // R0: Arduino 0  = P0.06
        , <&gpio0 17 (GPIO_ACTIVE_HIGH | GPIO_PULL_DOWN)>   // R1: Arduino 2  = P0.17
        , <&gpio0 22 (GPIO_ACTIVE_HIGH | GPIO_PULL_DOWN)>   // R2: Arduino 4  = P0.22
        , <&gpio1 6  (GPIO_ACTIVE_HIGH | GPIO_PULL_DOWN)>   // R3: Arduino 9  = P1.06
        , <&gpio1 1  (GPIO_ACTIVE_HIGH | GPIO_PULL_DOWN)>   // R4: Arduino 18 = P1.01
        ;
};
